## CMakeLists.txt
```
# SPDX-License-Identifier: Apache-2.0

cmake_minimum_required(VERSION 3.20.0)
find_package(Zephyr REQUIRED HINTS $ENV{ZEPHYR_BASE})
project(peripheral)

target_sources(app PRIVATE
  src/main.c
  src/model.c
  src/mible_core.c
  src/mi_mesh_otp.c
# src/mi_potp_0xec4d3ebdd2c1.c
  src/nvm.c
  src/mible_crypto.c
  src/mi_crypto_backend_mbedtls.c
  src/third_party/mbedtls/asn1parse.c
  src/third_party/mbedtls/sha256.c
  src/third_party/mbedtls/sha256_hkdf.c
  src/third_party/mbedtls/md.c
  src/third_party/mbedtls/md_wrap.c
  src/third_party/mbedtls/ccm.c
  src/third_party/mbedtls/base64.c
  src/third_party/micro-ecc/uECC.c
)

add_definitions(-DuECC_VLI_NATIVE_LITTLE_ENDIAN=0)
```

## Kconfig
```
config MIBLE_SDK
	bool "Enable mijia Mesh App"
	default n
	help
	  This option enables support for mijia mesh app

config MIBLE_STANDARD
	bool "Enable mijia standard auth App"
	default n
	help
	  This option enables support for mijia standard app

config MIBLE_PSK
	bool "Enable mijia psk auth App"
	default n
	help
	  This option enables support for mijia psk app

config MIBLE_HAVE_MSC
        bool
        default n

choice
	prompt "Mijia MSC"
	default MIBLE_MSC_NONE

config MIBLE_MSC_NONE
	bool "MSC None"
	help
         None

config MIBLE_MSC_MJA1
	bool "MSC MJA1"
	depends on I2C
        select MIBLE_HAVE_MSC
	help
         None

config MIBLE_MSC_MJA2
	bool "MSC MJA2"
	depends on I2C
        select MIBLE_HAVE_MSC
	help
         None

endchoice

config MIBLE_SDK_STACK_SIZE
	int "Stack size for mijia Mesh App"
	default 4096
	depends on MIBLE_SDK

config MIBLE_SDK_USE_SRC
	bool "Use source code for mijia_ble_libs"
	default n
	depends on MIBLE_SDK
	help
	  This option used for ar mijia_ble_libs or used as source mode.

config MIBLE_SDK_LOG
	bool "Enable log debug function"
	default n
	depends on MIBLE_SDK

config MIBLE_MESH_MULT_SUB
	bool "Enable muti group sub func"
	default n
	depends on MIBLE_SDK

config MIBLE_MESH_CONFIG
	bool "Enable vendor config func"
	default n
	depends on MIBLE_SDK

config MIBLE_USE_MCU_OTA
	bool "Enable mcu ota function"
	default n
	depends on MIBLE_SDK

config MIBLE_BOARD_NAME
	string "mijia ble mesh board name"
	default "rtl8762e"
```

## prj.conf
```kconfig
# Increased stack due to settings API usage
CONFIG_SYSTEM_WORKQUEUE_STACK_SIZE=2048
CONFIG_MAIN_STACK_SIZE=4096

CONFIG_FLASH=y
CONFIG_FLASH_MAP=y
CONFIG_NVS=y
CONFIG_SETTINGS=y

CONFIG_HEAP_MEM_POOL_SIZE=2048

CONFIG_REBOOT=y

CONFIG_BT=y
CONFIG_BT_HCI_VS=y
CONFIG_BT_SETTINGS=y
CONFIG_BT_AUTO_PHY_UPDATE=n
CONFIG_BT_AUTO_DATA_LEN_UPDATE=n
CONFIG_BT_BUF_ACL_RX_COUNT=3
CONFIG_BT_BUF_ACL_RX_SIZE=120
CONFIG_BT_BUF_ACL_TX_SIZE=120
CONFIG_BT_BUF_CMD_TX_COUNT=3
CONFIG_BT_BUF_CMD_TX_SIZE=255
CONFIG_BT_BUF_EVT_DISCARDABLE_COUNT=3
CONFIG_BT_BUF_EVT_DISCARDABLE_SIZE=255
CONFIG_BT_BUF_EVT_RX_COUNT=5
CONFIG_BT_BUF_EVT_RX_SIZE=70
CONFIG_BT_GATT_ENFORCE_SUBSCRIPTION=n
CONFIG_BT_SETTINGS_CCC_LAZY_LOADING=n
CONFIG_BT_SETTINGS_CCC_STORE_ON_WRITE=n
CONFIG_BT_CONN_PARAM_UPDATE_TIMEOUT=1000
CONFIG_BT_CONN_TX_MAX=4
CONFIG_BT_DEBUG_LOG=y
CONFIG_BT_DEVICE_NAME="mijia_ble_mesh"
CONFIG_BT_ECC=n
CONFIG_BT_EXT_ADV=y
CONFIG_BT_EXT_ADV_MAX_ADV_SET=4
CONFIG_BT_EXT_SCAN_BUF_SIZE=255
CONFIG_BT_L2CAP_TX_FRAG_COUNT=0
CONFIG_BT_L2CAP_TX_MTU=120
CONFIG_BT_MESH=y
CONFIG_BT_MESH_PROV_DEVICE=n
CONFIG_BT_MESH_PB_ADV=n
CONFIG_BT_MESH_ADV_BUF_COUNT=8
CONFIG_BT_MESH_CRPL=32
CONFIG_BT_MESH_LOG_LEVEL_DBG=y
CONFIG_BT_MESH_DEBUG_USE_ID_ADDR=y
CONFIG_BT_MESH_DEFAULT_TTL=5
CONFIG_BT_MESH_IVU_DIVIDER=8
CONFIG_BT_MESH_IV_UPDATE_SEQ_LIMIT=0xF00000
CONFIG_BT_MESH_LABEL_COUNT=0
CONFIG_BT_MESH_LOOPBACK_BUFS=0
CONFIG_BT_MESH_MODEL_GROUP_COUNT=10
CONFIG_BT_MESH_MSG_CACHE_SIZE=64
CONFIG_BT_MESH_NETWORK_TRANSMIT_COUNT=7
CONFIG_BT_MESH_NETWORK_TRANSMIT_INTERVAL=10
CONFIG_BT_MESH_RELAY=y
CONFIG_BT_MESH_RELAY_ADV_SETS=2
CONFIG_BT_MESH_RELAY_BUF_COUNT=6
CONFIG_BT_MESH_RELAY_RETRANSMIT_INTERVAL=40
CONFIG_BT_MESH_SEG_BUFS=3
CONFIG_BT_OBSERVER=y
CONFIG_BT_PERIPHERAL=y
CONFIG_BT_PERIPHERAL_PREF_MAX_INT=24
CONFIG_BT_PERIPHERAL_PREF_MIN_INT=12
CONFIG_BT_PERIPHERAL_PREF_TIMEOUT=90
CONFIG_BT_RX_STACK_SIZE=2560
CONFIG_BT_BUF_EVT_DISCARDABLE_SIZE=255

CONFIG_BT_MESH_EXT_ADV=y
CONFIG_BT_MESH_PATH=y
CONFIG_BT_MESH_PSK=y
```

## src/mesh_vnd_df.h
```c
#ifndef __MESH_VND_DF_H
#define __MESH_VND_DF_H

#include <bluetooth/mesh.h>

// TODO: rename or redefine those opcodes
#define ALL_DF_NODES           0xFEDF

#define DF_REQ  0x00DA
#define DF_RSP  0x00DB
#define DF_CFM  0x00DC
#define DF_DEL  0x00DD
#define DF_DCFM 0x00DE

enum path_status {
    PATH_TO_TARGET_FOUND,
    PATH_TO_ORIGIN_FOUND,
    PATH_DISCOVER_END,
    PATH_EXPIRED,
    PATH_TARGET_EXPIRED,

    // DEBUG ONLY
    NODE_SELECTED_AS_PATH,
    NODE_PATH_REVOKE,
    GROUP_PATH_TO_TARGET_FOUND,     //fn -> uni_addr[0], lane_id uni_addr[1]
    GROUP_PATH_TO_ORIGIN_FOUND,
};

struct path_param {
    uint8_t path_life        :2;    // lifetime = ( path_life + 1 ) * 15 min
    uint8_t path_rssi        :2;    // rssi_thershold = -80 + path_rssi * 5
    uint8_t nettx_double     :1;
    uint8_t reserved         :3;
};

typedef void (*path_callback_t)(enum path_status, uint32_t path, uint8_t fn, uint8_t lane_id, uint8_t result);

int vnd_miot_path_request(struct bt_mesh_model *model,
        struct bt_mesh_msg_ctx *ctx,
        struct net_buf_simple *buf);

int vnd_miot_path_reply(struct bt_mesh_model *model,
        struct bt_mesh_msg_ctx *ctx,
        struct net_buf_simple *buf);

int vnd_miot_path_confirm(struct bt_mesh_model *model,
        struct bt_mesh_msg_ctx *ctx,
        struct net_buf_simple *buf);

int vnd_miot_path_delete(struct bt_mesh_model *model,
        struct bt_mesh_msg_ctx *ctx,
        struct net_buf_simple *buf);

int vnd_miot_path_delcfm(struct bt_mesh_model *model,
        struct bt_mesh_msg_ctx *ctx,
        struct net_buf_simple *buf);

int mesh_path_enable(path_callback_t cb);

int discover_path_to_target(struct path_param *param, uint16_t target_addr, uint8_t fn, uint8_t lane_id);

int is_path_msg(struct bt_mesh_msg_ctx *ctx);

int is_not_relayable_path_msg(struct bt_mesh_msg_ctx *ctx);

int bt_mesh_path_relay_retransmit_get(struct bt_mesh_msg_ctx *ctx);

int del_one_path(uint16_t path_origin, uint16_t path_target, uint16_t delays, void **path_find);

void del_all_path(void);

#endif
```

## src/mesh_vnd_lpn.h
```c
#ifndef __MESH_VND_LPN_H
#define __MESH_VND_LPN_H

#include <bluetooth/mesh.h>

#define PA_REQ  0x00D7
#define PA_RSP  0x00D8
#define PA_CFM  0x00D9

enum sync_status {
    SYNC_ESTABLISH,
    SYNC_LOST,
    SYNC_FAILED,
};

typedef struct {
    uint8_t req_node_feature_map :1;
    uint8_t req_gw_feature_map   :1;
    uint8_t rfu:6;
} __packed feature_map_req_t;

typedef struct {
    uint8_t bitmap[7];
} __packed feature_map_rsp_t;

typedef struct {
    uint8_t sid;
    uint8_t addr[6];
}__packed per_adv_sync_req_t;

typedef struct {
    uint8_t result;
}__packed per_adv_sync_rsp_t;

typedef struct{
    uint16_t net_idx;
    uint16_t app_idx;
    uint16_t addr;
}__packed per_adv_sync_gw_info_t;

typedef enum {
    PER_ADV_SYNC_IDLE,
    PER_ADV_SYNC_INIT,
    PER_ADV_SYNC_REQ_GW_GROUP_ADDR,
    PER_ADV_SYNC_SELECT_GW_NODE,
    PER_ADV_SYNC_GW_NODE_FIND_NONE,
    PER_ADV_SYNC_REQ_GW_UNICAST_ADDR,
    PER_ADV_SYNC_START,
    PER_ADV_SYNC_FAIL,
    PER_ADV_SYNC_ESTABLISH,
    PER_ADV_SYNC_LOST,
    PER_ADV_SYNC_SUCCESS,
    PER_ADV_SYNC_STOP
}per_adv_sync_dev_state_t;

typedef void (*sync_callback_t)(per_adv_sync_dev_state_t status, uint16_t node_addr, void * data);
int mesh_vnd_per_adv_respond(struct bt_mesh_model *model,
        struct bt_mesh_msg_ctx *ctx,
        struct net_buf_simple *buf);

int mesh_vnd_per_adv_sync_stop(void);
int mesh_vnd_per_adv_sync_recv_enable(bool enable);


// GATEWAY SIDE
int mesh_vnd_per_adv_enable(sync_callback_t cb);

// NODE SIDE
int mesh_vnd_per_adv_sync_enable(sync_callback_t cb);

int mesh_vnd_per_adv_sync_request(void);

void mesh_vnd_per_adv_set_gw_info(uint16_t gw_addr, uint16_t net_idx, uint16_t app_idx);
void mesh_vnd_per_adv_get_gw_info(per_adv_sync_gw_info_t* gw_info);
uint8_t mesh_vnd_is_per_adv_running(void);
#endif
```

## src/mi_crypto_backend_mbedtls.c
```c
#include <zephyr/types.h>
#include <string.h>

#include "mi_crypto_backend_mbedtls.h"
#include "third_party/mbedtls/asn1.h"
#include "third_party/mbedtls/sha256_hkdf.h"
#include "third_party/mbedtls/ccm.h"
#include "third_party/mbedtls/base64.h"

#define CHECK(code)                                                                                \
    if ((ret = code) != 0) {                                                                   \
        return (ret);                                                                      \
    }
#define CHECK_RANGE(min, max, val)                                                                 \
    if (val < min || val > max) {                                                              \
        return (ret);                                                                      \
    }

static int x509_parse_int(unsigned char **p, size_t n, int *res)
{
    *res = 0;

    for (; n > 0; --n) {
        if ((**p < '0') || (**p > '9')) {
            return (-1);
        }

        *res *= 10;
        *res += (*(*p)++ - '0');
    }

    return (0);
}

static int x509_date_is_valid(const msc_crt_time *t)
{
    int ret = -1;

    CHECK_RANGE(0, 9999, t->year);
    CHECK_RANGE(0, 23, t->hour);
    CHECK_RANGE(0, 59, t->min);
    CHECK_RANGE(0, 59, t->sec);

    switch (t->mon) {
    case 1:
    case 3:
    case 5:
    case 7:
    case 8:
    case 10:
    case 12:
        CHECK_RANGE(1, 31, t->day);
        break;
    case 4:
    case 6:
    case 9:
    case 11:
        CHECK_RANGE(1, 30, t->day);
        break;
    case 2:
        CHECK_RANGE(1, 28 + (t->year % 4 == 0), t->day);
        break;
    default:
        return (ret);
    }

    return (0);
}

/*
 * Parse an ASN1_UTC_TIME (yearlen=2) or ASN1_GENERALIZED_TIME (yearlen=4)
 * field.
 */
static int x509_parse_time(unsigned char **p, size_t len, size_t yearlen, msc_crt_time *tm)
{
    int ret;

    /*
     * Minimum length is 10 or 12 depending on yearlen
     */
    if (len < yearlen + 8) {
        return (-1);
    }
    len -= yearlen + 8;

    /*
     * Parse year, month, day, hour, minute
     */
    CHECK(x509_parse_int(p, yearlen, &tm->year));
    if (2 == yearlen) {
        if (tm->year < 50) {
            tm->year += 100;
        }

        tm->year += 1900;
    }

    CHECK(x509_parse_int(p, 2, &tm->mon));
    CHECK(x509_parse_int(p, 2, &tm->day));
    CHECK(x509_parse_int(p, 2, &tm->hour));
    CHECK(x509_parse_int(p, 2, &tm->min));

    /*
     * Parse seconds if present
     */
    if (len >= 2) {
        CHECK(x509_parse_int(p, 2, &tm->sec));
        len -= 2;
    } else {
        return (-2);
    }

    /*
     * Parse trailing 'Z' if present
     */
    if (1 == len && 'Z' == **p) {
        (*p)++;
        len--;
    }

    /*
     * We should have parsed all characters at this point
     */
    if (0 != len) {
        return (-3);
    }

    CHECK(x509_date_is_valid(tm));

    return (0);
}

/*
 *  Time ::= CHOICE {
 *       utcTime        UTCTime,
 *       generalTime    GeneralizedTime }
 */
static int x509_get_time(unsigned char **p, const unsigned char *end, msc_crt_time *tm)
{
    int ret;
    size_t len, year_len;
    unsigned char tag;

    if ((end - *p) < 1) {
        return -1;
    }

    tag = **p;

    if (tag == MBEDTLS_ASN1_UTC_TIME) {
        year_len = 2;
    } else if (tag == MBEDTLS_ASN1_GENERALIZED_TIME) {
        year_len = 4;
    } else {
        return -2;
    }

    (*p)++;
    ret = mbedtls_asn1_get_len(p, end, &len);

    if (ret != 0) {
        return (-3);
    }

    return x509_parse_time(p, len, year_len, tm);
}

static int x509_get_notafter(unsigned char *start, const unsigned char *end, msc_crt_time *tm)
{
    unsigned char *p_tmp = start;
    unsigned char **p = &p_tmp;

    return (x509_get_time(p, end, tm) | x509_get_time(p, end, tm));
}

static int x509_check_time(const msc_crt_time *before, const msc_crt_time *after)
{
    if (before->year > after->year) {
        return (1);
    }

    if (before->year == after->year && before->mon > after->mon) {
        return (1);
    }

    if (before->year == after->year && before->mon == after->mon && before->day > after->day) {
        return (1);
    }

    if (before->year == after->year && before->mon == after->mon && before->day == after->day &&
        before->hour > after->hour) {
        return (1);
    }

    if (before->year == after->year && before->mon == after->mon && before->day == after->day &&
        before->hour == after->hour && before->min > after->min) {
        return (1);
    }

    if (before->year == after->year && before->mon == after->mon && before->day == after->day &&
        before->hour == after->hour && before->min == after->min && before->sec > after->sec) {
        return (1);
    }

    return (0);
}
/*
 *  Version  ::=  INTEGER  {  v1(0), v2(1), v3(2)  }
 */
static int x509_get_version(unsigned char **p, const unsigned char *end, int *ver)
{
    int ret;
    size_t len;

    if ((ret = mbedtls_asn1_get_tag(
             p, end, &len, MBEDTLS_ASN1_CONTEXT_SPECIFIC | MBEDTLS_ASN1_CONSTRUCTED | 0)) !=
        0) {
        if (ret == MBEDTLS_ERR_ASN1_UNEXPECTED_TAG) {
            *ver = 0;
            return (0);
        }

        return (ret);
    }

    end = *p + len;

    if ((ret = mbedtls_asn1_get_int(p, end, ver)) != 0) {
        return (ret);
    }

    if (*p != end) {
        return (-1);
    }

    return (0);
}
/*
 *  CertificateSerialNumber  ::=  INTEGER
 */
static int x509_get_serial(unsigned char **p, const unsigned char *end, mbedtls_asn1_buf *serial)
{
    int ret;

    if ((end - *p) < 1) {
        return -1;
    }

    if (**p != (MBEDTLS_ASN1_CONTEXT_SPECIFIC | MBEDTLS_ASN1_PRIMITIVE | 2) &&
        **p != MBEDTLS_ASN1_INTEGER) {
        return -2;
    }

    serial->tag = *(*p)++;

    ret = mbedtls_asn1_get_len(p, end, &serial->len);
    if (ret != 0) {
        return -3;
    }

    serial->p = *p;
    *p += serial->len;

    return (0);
}

/*
 *  AttributeTypeAndValue ::= SEQUENCE {
 *    type     AttributeType,
 *    value    AttributeValue }
 *
 *  AttributeType ::= OBJECT IDENTIFIER
 *
 *  AttributeValue ::= ANY DEFINED BY AttributeType
 */
static int x509_get_attr_type_value(unsigned char **p, const unsigned char *end,
                    mbedtls_asn1_named_data *cur)
{
    int ret;
    size_t len;
    mbedtls_asn1_buf *oid;
    mbedtls_asn1_buf *val;

    if ((ret = mbedtls_asn1_get_tag(p, end, &len,
                    MBEDTLS_ASN1_CONSTRUCTED | MBEDTLS_ASN1_SEQUENCE)) != 0) {
        return (-91 + ret);
    }

    if ((end - *p) < 1) {
        return (-91 + MBEDTLS_ERR_ASN1_OUT_OF_DATA);
    }

    oid = &cur->oid;
    oid->tag = **p;

    if ((ret = mbedtls_asn1_get_tag(p, end, &oid->len, MBEDTLS_ASN1_OID)) != 0) {
        return (-91 + ret);
    }

    oid->p = *p;
    *p += oid->len;

    if ((end - *p) < 1) {
        return (-91 + MBEDTLS_ERR_ASN1_OUT_OF_DATA);
    }

    if (**p != MBEDTLS_ASN1_BMP_STRING && **p != MBEDTLS_ASN1_UTF8_STRING &&
        **p != MBEDTLS_ASN1_T61_STRING && **p != MBEDTLS_ASN1_PRINTABLE_STRING &&
        **p != MBEDTLS_ASN1_IA5_STRING && **p != MBEDTLS_ASN1_UNIVERSAL_STRING &&
        **p != MBEDTLS_ASN1_BIT_STRING) {
        return (-91 + MBEDTLS_ERR_ASN1_UNEXPECTED_TAG);
    }

    val = &cur->val;
    val->tag = *(*p)++;

    if ((ret = mbedtls_asn1_get_len(p, end, &val->len)) != 0) {
        return (-91 + ret);
    }

    val->p = *p;
    *p += val->len;

    cur->next = NULL;

    return (0);
}
static int x509_get_name(unsigned char **p, const unsigned char *end, uint8_t id,
             mbedtls_asn1_buf *val)
{
    int ret;
    size_t set_len;
    const unsigned char *end_set;

    mbedtls_asn1_named_data cur_buf;
    mbedtls_asn1_named_data *cur = &cur_buf;
    while (1) {
        /*
         * parse SET
         */
        if ((ret = mbedtls_asn1_get_tag(
                 p, end, &set_len, MBEDTLS_ASN1_CONSTRUCTED | MBEDTLS_ASN1_SET)) != 0) {
            return (-91 + ret);
        }

        end_set = *p + set_len;

        while (1) {
            if ((ret = x509_get_attr_type_value(p, end_set, cur)) != 0) {
                return (ret);
            }

            if (cur->oid.p[cur->oid.len - 1] == id) { /* found the specified oid */
                memcpy(val, &cur->val, sizeof(mbedtls_asn1_buf));
            }

            if (*p == end_set) {
                break;
            }
        }

        /*
         * continue until end of SEQUENCE is reached
         */
        if (*p == end) {
            return (0);
        }
    }
}

int mbedtls_crt_parse_der(const unsigned char *crt, size_t crt_sz, const msc_crt_time *now,
              msc_crt_t *msc_crt)
{
    int ret = 0;
    unsigned char *p, *end, *p_tmp, *crt_end;
    size_t len;

    if (!crt || !crt_sz) {
        return -1;
    }

    p = (unsigned char *)crt;
    end = p + crt_sz;

    /*
     * Certificate  ::=  SEQUENCE  {
     *      tbsCertificate       TBSCertificate,
     *      signatureAlgorithm   AlgorithmIdentifier,
     *      signatureValue       BIT STRING  }
     */
    if ((ret = mbedtls_asn1_get_tag(&p, end, &len,
                    MBEDTLS_ASN1_CONSTRUCTED | MBEDTLS_ASN1_SEQUENCE)) != 0 ||
        len > (size_t)(end - p)) {
        ret = -2;
        goto done;
    }

    /* got cert raw and save start and end */
    p_tmp = p;
    crt_end = p + len;

    /*
     * TBSCertificate  ::=  SEQUENCE  {
     */
    end = crt_end;
    if ((ret = mbedtls_asn1_get_tag(&p, end, &len,
                    MBEDTLS_ASN1_CONSTRUCTED | MBEDTLS_ASN1_SEQUENCE)) != 0) {
        ret = -3;
        goto done;
    }

    /* got tbs */
    msc_crt->tbs.p = p_tmp;
    msc_crt->tbs.len = p + len - p_tmp;

    /* save tbs end since when don't parse whole tbs now */
    p_tmp = p + len;
    end = p_tmp;
    /*
     * Version  ::=  INTEGER  {  v1(0), v2(1), v3(2)  }
     */
    int ver;
    if ((ret = x509_get_version(&p, end, &ver)) != 0 || (ver < 0 || ver > 2)) {
        ret = -4;
        goto done;
    }

    /*
     * CertificateSerialNumber  ::=  INTEGER
     */
    mbedtls_asn1_buf sn_buf;
    if ((ret = x509_get_serial(&p, end, &sn_buf)) != 0) {
        ret = -5;
        goto done;
    }
    /* got sn */
    msc_crt->sn.p = sn_buf.p;
    msc_crt->sn.len = sn_buf.len;

    /*
     * signature            AlgorithmIdentifier
     */
    if ((ret = mbedtls_asn1_get_tag(&p, end, &len,
                    MBEDTLS_ASN1_CONSTRUCTED | MBEDTLS_ASN1_SEQUENCE)) != 0) {
        ret = -6;
        goto done;
    }

    p += len;
    /*
     * issuer               Name
     */
    if ((ret = mbedtls_asn1_get_tag(&p, end, &len,
                    MBEDTLS_ASN1_CONSTRUCTED | MBEDTLS_ASN1_SEQUENCE)) != 0) {
        ret = -7;
        goto done;
    }

    p += len;
    /*
     * Validity ::= SEQUENCE {
     *      notBefore      Time,
     *      notAfter       Time }
     *
     */
    {
        msc_crt_time time;
        if ((ret = mbedtls_asn1_get_tag(
                 &p, end, &len, MBEDTLS_ASN1_CONSTRUCTED | MBEDTLS_ASN1_SEQUENCE)) !=
                0 ||
            x509_get_notafter(p, p + len, &time)) {
            ret = -8;
            goto done;
        }

        if (now != NULL && x509_check_time(now, &time)) {
            ret = -81;
            goto done;
        }
    }
    p += len;
    /*
     * subject              Name
     */
    if ((ret = mbedtls_asn1_get_tag(&p, end, &len,
                    MBEDTLS_ASN1_CONSTRUCTED | MBEDTLS_ASN1_SEQUENCE)) != 0) {
        ret = -9;
        goto done;
    }

    {
        mbedtls_asn1_buf sub_o = {0};
        if (len && (ret = x509_get_name(&p, p + len, 0x0A, &sub_o)) != 0) {
            return (-91);
        }
        /* got sub_o */
        msc_crt->sub_o.p = sub_o.p;
        msc_crt->sub_o.len = sub_o.len;
    }

    /*
     * SubjectPublicKeyInfo
     */
    if ((ret = mbedtls_asn1_get_tag(&p, end, &len,
                    MBEDTLS_ASN1_CONSTRUCTED | MBEDTLS_ASN1_SEQUENCE)) != 0) {
        ret = -10;
        goto done;
    }

    /* Public Key Algorithm */
    if ((ret = mbedtls_asn1_get_tag(&p, p + len, &len,
                    MBEDTLS_ASN1_CONSTRUCTED | MBEDTLS_ASN1_SEQUENCE)) != 0) {
        ret = -11;
        goto done;
    }

    p += len;
    /* Subject Public Key */
    if ((ret = mbedtls_asn1_get_bitstring_null(&p, end, &len)) != 0) {
        ret = -12;
        goto done;
    }

    msc_crt->pub.p = p + 1;
    msc_crt->pub.len = len - 1;

    /*
     *  }
     *  -- end of TBSCertificate
     *
     *  signatureAlgorithm   AlgorithmIdentifier,
     *  signatureValue       BIT STRING
     */
    p = p_tmp;
    end = crt_end;
    /* parse signatureAlgorithm */
    if ((ret = mbedtls_asn1_get_tag(&p, end, &len,
                    MBEDTLS_ASN1_CONSTRUCTED | MBEDTLS_ASN1_SEQUENCE)) != 0) {
        ret = -13;
        goto done;
    }

    /* parse signatureValue */
    p += len;
    if ((ret = mbedtls_asn1_get_bitstring_null(&p, end, &len)) != 0) {
        ret = -14;
        goto done;
    }

    end = p + len;
    if ((ret = mbedtls_asn1_get_tag(&p, end, &len,
                    MBEDTLS_ASN1_CONSTRUCTED | MBEDTLS_ASN1_SEQUENCE)) != 0) {
        ret = -15;
        goto done;
    }

    end = p + len;
    if ((ret = mbedtls_asn1_get_tag(&p, end, &len, MBEDTLS_ASN1_INTEGER)) != 0) {
        ret = -16;
        goto done;
    }

    /* got first bignum which <= 32 bytes */
    memset(msc_crt->sig, 0, MSC_CRT_SIG_SZ);
    /* when the first byte > 0x7f, the ASN.1 will prepend 0x00, so remove it */
    if (len >= 0x20) {
        memcpy(msc_crt->sig, p + len - 0x20, 0x20);
    } else { /* if the bignum less than 32 bytes, prepend 0x00(the bignum is big endian) */
        memcpy(msc_crt->sig + 0x20 - len, p, len);
    }

    p += len;
    if ((ret = mbedtls_asn1_get_tag(&p, end, &len, MBEDTLS_ASN1_INTEGER)) != 0) {
        ret = -17;
        goto done;
    }

    if (len >= 0x20) {
        memcpy(&msc_crt->sig[0x20], p + len - 0x20, 0x20);
    } else {
        memcpy(&msc_crt->sig[0x40 - len], p, len);
    }

done:
    return ret;
}

int mbedtls_crt_pem2der(const unsigned char *pem, size_t pem_sz, unsigned char *der_buf,
            size_t buf_sz)
{
    const unsigned char *s1, *s2;
    size_t der_sz = 0;

    if (!pem || !der_buf) {
        goto done;
    }

    s1 = (unsigned char *)strstr((const char *)pem, PEM_HEADER);
    if (s1 == NULL) {
        goto done;
    }

    s2 = (unsigned char *)strstr((const char *)pem, PEM_FOOTER);
    if (s2 == NULL || s2 <= s1 || s2 - s1 > pem_sz) {
        goto done;
    }

    s1 += strlen(PEM_HEADER);
    mbedtls_base64_decode(der_buf, buf_sz, &der_sz, s1, s2 - s1);

done:
    return der_sz;
}

int mbedtls_read_signature(const unsigned char *sign_der, uint16_t sign_sz, uint8_t *out_buf,
               uint16_t out_sz)
{
    int ret = 0;
    unsigned char *p, *end;
    size_t len;

    if (!sign_der || !out_buf || out_sz < MSC_CRT_SIG_SZ) {
        return -1;
    }

    p = (unsigned char *)sign_der;
    end = p + sign_sz;

    if ((ret = mbedtls_asn1_get_tag(&p, end, &len,
                    MBEDTLS_ASN1_CONSTRUCTED | MBEDTLS_ASN1_SEQUENCE)) != 0) {
        ret = -15;
        goto done;
    }

    end = p + len;
    if ((ret = mbedtls_asn1_get_tag(&p, end, &len, MBEDTLS_ASN1_INTEGER)) != 0) {
        ret = -16;
        goto done;
    }

    /* got first bignum which <= 32 bytes */
    memset(out_buf, 0, MSC_CRT_SIG_SZ);
    /* when the first byte > 0x7f, the ASN.1 will prepend 0x00, so remove it */
    if (len >= 0x20) {
        memcpy(out_buf, p + len - 0x20, 0x20);
    } else { /* if the bignum less than 32 bytes, prepend 0x00(the bignum is big endian) */
        memcpy(out_buf + 0x20 - len, p, len);
    }

    p += len;
    if ((ret = mbedtls_asn1_get_tag(&p, end, &len, MBEDTLS_ASN1_INTEGER)) != 0) {
        ret = -17;
        goto done;
    }

    if (len >= 0x20) {
        memcpy(&out_buf[0x20], p + len - 0x20, 0x20);
    } else {
        memcpy(&out_buf[0x40 - len], p, len);
    }

done:
    return ret;
}
```

## src/mi_crypto_backend_mbedtls.h
```c
#ifndef __MIBLE_CRYPTO_BACKEND_MBEDTLS_H__
#define __MIBLE_CRYPTO_BACKEND_MBEDTLS_H__
#include <stdint.h>
#include <stddef.h>

#define PEM_HEADER "-----BEGIN CERTIFICATE-----"
#define PEM_FOOTER "-----END CERTIFICATE-----"

/** Container for date and time (precision in seconds). */
typedef struct {
    int year, mon, day; /**< Date. */
    int hour, min, sec; /**< Time. */
} msc_crt_time;

typedef struct {
    unsigned char *p;
    size_t len;
} msc_crt_item_t;

#define MSC_CRT_SIG_SZ 64
typedef struct {
    msc_crt_item_t tbs;           /* to be signed */
    msc_crt_item_t pub;           /* public key */
    msc_crt_item_t sn;           /* serial number */
    msc_crt_item_t sub_o;           /* subject O */
    unsigned char sig[MSC_CRT_SIG_SZ]; /* signature */
} msc_crt_t;

/**
 * @brief x509 DER crt parse
 *
 * @param raw_crt - input crt in DER format
 * @param raw_crt_sz
 * @param now - current time in GMT
 * @param msc_crt - output parsed crt
 *
 * @return 0-OK
 */
int mbedtls_crt_parse_der(const unsigned char *raw_crt, size_t raw_crt_sz, const msc_crt_time *now,
              msc_crt_t *msc_crt);
int mbedtls_crt_pem2der(const unsigned char *pem, size_t pem_sz, unsigned char *der_buf,
            size_t buf_sz);
int mbedtls_read_signature(const unsigned char *sign_der, uint16_t sign_sz, uint8_t *out_buf,
               uint16_t out_sz);

#endif /* __MIBLE_CRYPTO_BACKEND_MSC_H__ END*/
```

## src/mi_mesh_otp.h
```c
#ifndef MIJIA_BLE_LIBS_CRYPTOGRAPHY_MI_MESH_OTP_H_
#define MIJIA_BLE_LIBS_CRYPTOGRAPHY_MI_MESH_OTP_H_
#include <zephyr/types.h>
#include <stdbool.h>
#include <stdint.h>

/*  OTP_ITEM_TYPE  */
#define OTP_MARK_DIRTY      0x00
#define OTP_DEV_CERT        0x01
#define OTP_MANU_CERT       0x02
#define OTP_ROOT_CERT       0x03
#define OTP_DEV_CERT_PRI    0x04
#define OTP_DEV_PSK         0x05
#define OTP_BLE_MAC         0x10
#define OTP_META_DATA       0xF1
#define OTP_FREE_ITEM       0xFFFF

typedef struct {
    char        name[4];
    uint16_t    version;
    uint16_t    size;
} otp_head_t;

typedef struct {
    uint16_t            type;
    uint16_t            len;
    uint8_t             value[1];
} otp_item_t;

typedef int (*uart_sync_tx_t)(uint8_t const * const out, uint16_t olen);
typedef int (*uart_sync_rx_t)(uint8_t * const in, uint16_t max_ilen);
typedef void (*dbg_flash_lock_func_t)(void);

int mi_mesh_otp_seal_tag(uint8_t * base);
bool mi_mesh_otp_is_existed(void);
int mi_mesh_otp_manufacture_init(uart_sync_tx_t tx, uart_sync_rx_t rx,
        dbg_flash_lock_func_t lock_flash_fn, dbg_flash_lock_func_t lock_debug_fn);
int mi_mesh_otp_write(uint16_t item_type, const uint8_t *p_in, uint16_t in_len);
int mi_mesh_otp_read(uint16_t item_type, uint8_t *p_out, uint16_t max_olen);
int mi_mesh_otp_program(void);
int mi_mesh_otp_program_simulation(void);
int mi_mesh_otp_verify(void);

#endif /* MIJIA_BLE_LIBS_CRYPTOGRAPHY_MI_MESH_OTP_H_ */
```

## src/mible.h
```c
#ifndef MIBLE_H_
#define MIBLE_H_
#include <zephyr/types.h>
#include <stdbool.h>
#include <stdint.h>

#include <bluetooth/bluetooth.h>
#include "mible_dfu.h"
#include "mible_spec.h"

/* The following code defines three constants to represent the major, minor, and revision numbers of
 * the MIBLE library.
 */
#if defined(CONFIG_MIBLE_PSK) && (CONFIG_MIBLE_PSK)
#include "mible_psk_auth.h"

#define MIBLE_LIB_MAJOR                 3 // Represents the major version number.
#define MIBLE_LIB_MINOR                 0 // Represents the minor version number.
#define MIBLE_LIB_REVISION              0 // Represents the revision number.

#define MIBLE_AUTH_MODE                 3 // 2: Standard auth, 3: Psk auth
#else
#include "mesh_vnd_lpn.h"

#define MIBLE_LIB_MAJOR                 3 // Represents the major version number.
#define MIBLE_LIB_MINOR                 0 // Represents the minor version number.
#define MIBLE_LIB_REVISION              4 // Represents the revision number.
#endif

#define STR_VAL(str)                    #str
#define CONCAT_DEVELOPER_VERSION(x)     STR_VAL(x)
#define CONCAT_LIB_VERSION(x, y, z)     STR_VAL(x) "." STR_VAL(y) "." STR_VAL(z) "_"
#define CONCAT_VERSION(x, y, z, u)      STR_VAL(x) "." STR_VAL(y) "." STR_VAL(z) "_" STR_VAL(u)

/**< The UUID of the Xiaomi Service. */
#define BLE_UUID_MI_SERVICE             0xFE95
/**< The UUID of the Mi Service Version Characteristic. */
#define BLE_UUID_MI_VERS                0x0004
/**< The UUID of the WiFi Status Characteristic. */
#define BLE_UUID_MI_WIFI_CFG            0x0005
/**< The UUID of the Control Point Characteristic. */
#define BLE_UUID_MI_CTRLP               0x0010
/**< The UUID of the Secure Auth Characteristic. */
#define BLE_UUID_MI_SECURE              0x0016
/**< The UUID of the dfu Control Point Characteristic. */
#define BLE_UUID_MI_DFU_CTRL            0x0017
/**< The UUID of the dfu Data Characteristic. */
#define BLE_UUID_MI_DFU_DATA            0x0018
/**< The UUID of the Standard Auth Characteristic. */
#define BLE_UUID_MI_STANDARD            0x0019
/**< The UUID of the MIOT Spec RX Characteristic. */
#define BLE_UUID_MI_SPEC_RD             0x001A
/**< The UUID of the MIOT Spec TX Characteristic. */
#define BLE_UUID_MI_SPEC_WR             0x001B
/**< The UUID of the System info Characteristic. */
#define BLE_UUID_MI_SYS_INFO            0x001C

/* ATT MTU must be equal for RX and TX, so select the smallest value */
/* DMTU MIN(BT_L2CAP_TX_MTU, BT_L2CAP_TX_MTU) - ATT Header(3) - SN(2) - L2CAP Header(4, for Huawei Compatible) */
#define DMTU                            (MIN(CONFIG_BT_BUF_ACL_TX_SIZE - 4, CONFIG_BT_BUF_ACL_RX_SIZE - 4)  - 3 - 2 - 4)
#define MAX_CONSECTIVE_INTERVAL         400
#define MAX_RETRY_CNT                   (6)
#define MAX_LOST_RETRY_CNT              (3)
/*  SDU = EVT(255) - Field(26) - (Header(2) + Mode(1) + ExtHead(3) + CRC(3) + Resv(4)) 
        - (TypeLen(2) + NetHead(9) + NetMIC(4) + TransHead(1))
    DMTU = SDU - VendorOP(3) - TransMIC(4) - Tid/Handle(3) - PacketNum(2) */
#define DMTU_EXTADV                     ((CONFIG_BT_BUF_EVT_DISCARDABLE_SIZE - 39 - 16) - 3 - 4 - 3 - 2)
#define DMTU_MAX                        (MAX(DMTU, DMTU_EXTADV))
#define MAX_CONSECTIVE_INTERVAL_EXTADV  3000
#define NET_BUF_EXT_LEN                 2 //tid + handle

#define PASS_THROUGH                    0x00
#define DEV_CERT                        0x01
#define DEV_MANU_CERT                   0x02
#define ECC_PUBKEY                      0x03
#define DEV_SIGNATURE                   0x04
#define DEV_LOGIN_INFO                  0x05
#define DEV_SHARE_INFO                  0x06
#define SERVER_CERT                     0x07
#define SERVER_SIGN                     0x08
#define MESH_CONFIG                     0x09
#define APP_CONFIRMATION                0x0A
#define APP_RANDOM                      0x0B
#define DEV_CONFIRMATION                0x0C
#define DEV_RANDOM                      0x0D
#define BIND_KEY                        0x0E
#define WIFI_CONFIG                     0x0F

#define STATE_NONE                      0x00
#define STATE_WAIT_CMD                  0x01
#define STATE_WAIT_ACK                  0x02
#define STATE_TXD                       0x03
#define STATE_RXD                       0x04
#define STATE_ERROR                     0xFF

#define SEG_CMD                         0
#define SEG_ACK                         1
#define SGL_CMD                         2
#define SGL_ACK                         3
#define MNG_CMD                         4
#define MNG_ACK                         5
#define NIL_TYPE                        0xFF
#define FRAME_CTRL                      0

#define A_SUCCESS                       0
#define A_READY                         1
#define A_BUSY                          2
#define A_TIMEOUT                       3
#define A_CANCEL                        4
#define A_LOST                          5

#define M_FEATURE                       0
#define M_LENGTH                        1

struct rxfer_cb {
    void (*sent)(int err, uint8_t cmd, void *user_data);
    void (*recv)(int err, uint8_t cmd, uint8_t *val, uint16_t len, void *user_data);
    void (*mng)(int err, uint8_t cmd, const uint8_t val[]);
};

struct k_work_vendor{
    void *user_data;
    struct k_work work;
};

struct k_work_delayable_vendor{
    void *user_data;
    struct k_work_delayable work_delay;
};

enum {
    MIBLE_STATUS_BINDED,
    MIBLE_STATUS_LOGINED,
    MIBLE_STATUS_ADV_DISABLED,
    MIBLE_STATUS_BIND_CONFIRMED,
};

enum {
    MIBLE_TASK_USED,
};

typedef enum {
    MI_SUCCESS = 0x00,
    MI_ERR_INTERNAL,
    MI_ERR_NOT_FOUND,
    MI_ERR_NO_EVENT,
    MI_ERR_NO_MEM,
    MI_ERR_INVALID_ADDR,  // Invalid pointer supplied
    MI_ERR_INVALID_PARAM, // Invalid parameter(s) supplied.
    MI_ERR_INVALID_STATE, // Invalid state to perform operation.
    MI_ERR_INVALID_LENGTH,
    MI_ERR_DATA_SIZE,
    MI_ERR_TIMEOUT,
    MI_ERR_BUSY,
    MI_ERR_RESOURCES,
    MIBLE_ERR_INVALID_CONN_HANDLE,
    MIBLE_ERR_ATT_INVALID_ATT_HANDLE,
    MIBLE_ERR_GAP_INVALID_BLE_ADDR,
    MIBLE_ERR_GATT_INVALID_ATT_TYPE,
    MIBLE_ERR_UNKNOWN, // other ble stack errors
} mible_status_t;

typedef enum {
    MIBLE_DEV_INFO_SUPPORT = 0x00,
    MIBLE_DEV_INFO_MCU_VERSION,
    MIBLE_DEV_INFO_DEVICE_SN, // Max 18 byte
    MIBLE_DEV_INFO_HARDWARE_VERSION,
    MIBLE_DEV_INFO_LATITUDE,
    MIBLE_DEV_INFO_LONGITUDE,
    MIBLE_DEV_INFO_VENDOR1,
    MIBLE_DEV_INFO_VENDOR2,
    MIBLE_DEV_INFO_NEW_SN, // Max 64 byte
} mible_dev_info_type_t;

typedef struct {
    int code;
    uint8_t *buff;
    uint8_t len;
} mible_dev_info_t;

typedef void (*mible_dev_info_cb_t)(mible_dev_info_type_t type, mible_dev_info_t *buf);

typedef enum {
    MIBLE_USER_PROV_CB_TYPE_UNPROV = 0,
    MIBLE_USER_PROV_CB_TYPE_PROVED,
    MIBLE_USER_PROV_CB_TYPE_START,
    MIBLE_USER_PROV_CB_TYPE_COMPLETE,
    MIBLE_USER_PROV_CB_TYPE_FAIL,
    MIBLE_USER_PROV_CB_TYPE_RESET,
    MIBLE_USER_PROV_CB_TYPE_RECOVERY,
    MIBLE_USER_LOGIN_CB_TYPE_START,
    MIBLE_USER_LOGIN_CB_TYPE_COMPLETE,
    MIBLE_USER_LOGIN_CB_TYPE_FAIL,
    MIBLE_USER_GAP_CB_CONNECTED,
    MIBLE_USER_GAP_CB_DISCONNECTED,
    MIBLE_USER_SCENE_CB_ADD,
    MIBLE_USER_SCENE_CB_DELETE,
    MIBLE_USER_SCENE_CB_RECALL,
    MIBLE_USER_MIBEACON_SEND,
    MIBLE_USER_OOB_GENERATE,
    MIBLE_USER_OOB_INPUT,
} mible_user_event_type_t;

typedef void (*mible_user_event_cb_t)(mible_user_event_type_t event, void *user_data);

typedef bool (*mible_dfu_low_power_req_cb_t)(void);
typedef bool (*mible_dfu_pre_check_req_cb_t)(void);
typedef void (*mible_dfu_event_cb_t)(mible_dfu_state_t state, const mible_dfu_param_t *param);

typedef int (*mible_config_init_t)(void);

struct mible_config {
    uint32_t magic;
    struct {
        uint32_t pid;
        uint8_t model_name[BT_GAP_ADV_MAX_ADV_DATA_LEN - 2 + sizeof((char)'\0')];
        uint16_t dev_version;
        uint8_t *mcu_version;
        uint16_t io;
        uint8_t have_reset_button;
        uint8_t have_confirm_button;

        struct {
            mible_config_init_t gatt_spec_init;
            mible_config_init_t psk_init;
            mible_config_init_t path_init;
            mible_config_init_t lpn_init;
            mible_config_init_t mcu_ota_init;
        } init;
        struct {
            void *rx_buf;
            uint16_t max_rx_buf_len;

            uint16_t max_tx_buf_len;

            uint16_t max_tx_pool_num;
            struct mible_gatt_spec_tx *tx_pool;
        } gatt_spec;
    } cfg;

    struct {
        struct {
            mible_user_event_cb_t event;
        } event;

        struct {
            mible_dev_info_cb_t req;
        } dev_info;

        struct {
            mible_dfu_event_cb_t event;
            mible_dfu_pre_check_req_cb_t pre_check_req;
            mible_dfu_low_power_req_cb_t low_power_req;
        } dfu_info;

        struct {
            mible_property_operation_cb_t get;
            mible_property_operation_cb_t set;
            mible_action_operation_cb_t invoke;
        } spec;
#if defined(CONFIG_BT_PER_ADV_SYNC)
        struct {
            sync_callback_t sync;
        } pa_lpn;
#endif
    } cb;
};

typedef void (*mible_handler_t)(void *arg);

struct mible_task_item {
    sys_snode_t node;

    atomic_t flags;

    mible_handler_t handler;
    void *arg;
};


int mible_service_init(void);

int mible_otp_init(void);
int mible_record_delete(uint16_t record_id);
int mible_record_read(uint16_t record_id, uint8_t *p_data, uint16_t len);
int mible_record_read_ext(uint16_t record_id, uint8_t *p_data, uint16_t len, uint16_t *rd_len);
int mible_record_write(uint16_t record_id, const uint8_t *p_data, uint16_t len);

uint16_t mible_get_conn_handle(void);
mible_status_t mible_gap_disconnect(uint16_t conn_handle);

void mible_rxfer_reset(void);
void set_slave_mtu_intvl(uint16_t mtu, uint16_t intvl);
uint16_t get_exchanged_mtu(void);

void mible_single_task_post(struct mible_task_item *item, mible_handler_t handler, void *arg);
void evt_run_callback(uint8_t event, void *user_data);
void defer_task_process(void *args);
void mible_events_process(void);
void mible_core_enable_mcu_get_info(void);
void mible_mesh_enable_mcu_get_info(void);
#endif /* MIBLE_H_ */
```

## src/mible_beacon.h
```c
#ifndef MIBLE_BEACON_H_
#define MIBLE_BEACON_H_

#include <zephyr/types.h>
#include <stdbool.h>
#include <stdint.h>
#include <sys/atomic.h>
#include "mible.h"


/**
 * @note mibeacon object advertising configuration
 *
 * The mibeacon object is an adv message contains the status or event. BLE gateway
 * can receive the beacon message (by active scanning) and upload it to server for
 * triggering customized home automation scene.
 *
 * OBJ_QUEUE_SIZE      : max num of objects can be concurrency advertising
 *                       ( actually, it will be sent one by one )
 * OBJ_ADV_INTERVAL_MS : the object adv interval
 * OBJ_ADV_TIMEOUT_MS  : the time one object will be continuously sent.
 */

#ifndef OBJ_QUEUE_SIZE
#define OBJ_QUEUE_SIZE         8
#endif

#ifndef OBJ_ADV_INTERVAL_MS
#define OBJ_ADV_INTERVAL_MS    30
#endif

#ifndef OBJ_ADV_TIMEOUT_MS
#define OBJ_ADV_TIMEOUT_MS     1000
#endif


/**
 * @note Device side has RESET button.
 */
#ifndef HAVE_RESET_BUTTON
#define HAVE_RESET_BUTTON      1
#endif

/**
 * @note Device side has bind confirm button.
 */
#ifndef HAVE_CONFIRM_BUTTON
#define HAVE_CONFIRM_BUTTON    0
#endif

typedef uint8_t mible_addr_t[6];

typedef struct {
    uint8_t         reserved0           :1;
    uint8_t         reserved1           :1;
    uint8_t         compacted           :1;
    uint8_t         is_encrypt          :1;
    uint8_t         mac_include         :1;
    uint8_t         cap_include         :1;
    uint8_t         obj_include         :1;
    uint8_t         mesh_include        :1;

    uint8_t         registered          :1;
    uint8_t         solicite            :1;
    uint8_t         auth_mode           :2;
    uint8_t         version             :4;
} mibeacon_frame_ctrl_t;

typedef struct {
    void            *node;
    uint16_t        type;
    uint8_t         len;
    uint8_t         need_encrypt;
    uint8_t         compacted;
    uint8_t         val[12];
    atomic_t        flags;
 } mibeacon_obj_t;

struct mibeacon_obj {
    uint16_t        *type;
    uint8_t         len;
    uint8_t         *need_encrypt;
    uint8_t         *val;
 };

typedef struct {
    uint8_t         connectable  :1;
    uint8_t         centralable  :1;
    uint8_t         encryptable  :1;
    uint8_t         bondAbility  :2;
    uint8_t         IO_capability:1;
    uint8_t         reserved     :2;
} mibeacon_capability_t;

typedef struct {
    uint8_t in_digits            :1;
    uint8_t RFU0                 :1;
    uint8_t RFU1                 :1;
    uint8_t RFU2                 :1;
    uint8_t out_digits           :1;
    uint8_t RFU3                 :1;
    uint8_t RFU4                 :1;
    uint8_t out_image            :1;

    uint8_t reserved             :8;
} mibeacon_cap_sub_io_t;

typedef struct {
    uint8_t         pb_adv       :1;
    uint8_t         pb_gatt      :1;
    uint8_t         state        :2;
    uint8_t         version      :4;

    uint8_t         reserved     :8;
} mibeacon_mesh_t;

typedef struct {
    mibeacon_frame_ctrl_t   frame_ctrl;
    uint32_t                pid;
    mible_addr_t           *p_mac;
    mibeacon_capability_t  *p_capability;
    mibeacon_cap_sub_io_t  *p_cap_sub_IO;
    uint8_t                *p_wifi_mac;
    mibeacon_obj_t         **p_obj;
    uint8_t                 obj_num;
    mibeacon_mesh_t        *p_mesh;
} mibeacon_config_t;

typedef union {
    struct{
        uint16_t piid : 9;
        uint16_t flag : 1;
        uint16_t siid : 4;
        uint16_t head : 2;
    } prop;
    struct{
        uint16_t eiid : 9;
        uint16_t flag : 1;
        uint16_t siid : 4;
        uint16_t head : 2;
    } event;
    struct{
        uint16_t id : 4;
        uint16_t reserved :12;
    } packed;
    uint16_t all;
} spec_id_v2_t;

typedef struct{
    uint16_t object_id;
    uint8_t  len;
    uint8_t  val[12];
    uint8_t  remain;
    uint32_t seqnum;
}mible_arch_mibeacon_t;

void advertising_init(uint8_t solicite_bind);
int advertising_start(uint16_t adv_interval_ms);

int mibeacon_property_changed(uint8_t siid, uint16_t piid, mible_spec_property_value_t *newValue, uint8_t isUrgent);
int mibeacon_event_occurred(uint8_t siid, uint16_t eiid, mible_spec_arguments_t *newArgs, uint8_t isUrgent);

int mibeacon_init(uint8_t key[16], bool newone);
int mible_adv_start(void);
int mible_adv_suspend(void);
int mible_adv_resume(void);

#endif //MIBLE_BEACON_H_
```

## src/mible_crypto.c
```c
#include <zephyr/types.h>
#include <string.h>

#include "mible_crypto.h"
#include "third_party/mbedtls/ccm.h"

typedef struct {
    uint32_t iv;
    uint8_t reserve[4];
    uint32_t counter;
} session_nonce_t;

static uint32_t session_dev_cnt;
static uint32_t session_app_cnt;
static session_ctx_t *p_session;

static int update_cnt(uint32_t *p_cnt, uint16_t cnt_low)
{
    uint16_t last_cnt_low = *p_cnt;

    if ((last_cnt_low > 0x7FFF) && (cnt_low < 0x8000)) {
        *p_cnt += 0x10000UL;
    }

    *(uint16_t *)p_cnt = cnt_low;

    return 0;
}

int mi_session_init(session_ctx_t *p_ctx)
{
    if (p_ctx == NULL) {
        return 1;
    }

    p_session = p_ctx;

    session_app_cnt = 0;
    session_dev_cnt = 0;

    return 0;
}

void mi_session_uninit(void)
{
    p_session = NULL;
}

int mi_session_encrypt(const uint8_t *input, uint16_t ilen, uint8_t *output)
{
    if (!p_session) {
        return 1;
    }

    session_nonce_t nonce = {
        .iv = p_session->dev_iv,
    };

    uint16_t cnt_low = (uint16_t)session_dev_cnt;

    update_cnt(&session_dev_cnt, ++cnt_low);

    nonce.counter = session_dev_cnt;

    output[0] = (uint8_t)session_dev_cnt;
    output[1] = (uint8_t)(session_dev_cnt >> 8);

    return aes_ccm_encrypt_and_tag(p_session->dev_key, (void *)&nonce, sizeof(nonce), NULL, 0,
                       2 + input, ilen - 2, 2 + output, output + ilen, 4);
}

int mi_session_decrypt(const uint8_t *input, uint16_t ilen, uint8_t *output)
{
    uint32_t curr_cnt = session_app_cnt;

    if (!p_session) {
        return 1;
    }

    session_nonce_t nonce = {
        .iv = p_session->app_iv,
    };

    uint16_t cnt_low = (uint16_t)input[1] << 8 | input[0];

    update_cnt(&curr_cnt, cnt_low);

    if (curr_cnt <= session_app_cnt && curr_cnt != 0) {
        return -1;
    } else {
        session_app_cnt = curr_cnt;
    }

    nonce.counter = session_app_cnt;

    return aes_ccm_auth_decrypt(p_session->app_key, (void *)&nonce, sizeof(nonce), NULL, 0,
                    2 + input, ilen - 2 - 4, 2 + output, 2 + output + ilen - 2 - 4,
                    4);
}
```

## src/mible_crypto.h
```c
#ifndef __MIBLE_CRYPTO_H__
#define __MIBLE_CRYPTO_H__
#include <stdint.h>

typedef struct {
    uint8_t dev_key[16];
    uint8_t app_key[16];
    uint32_t dev_iv;
    uint32_t app_iv;
} session_ctx_t;

int mi_session_init(session_ctx_t *p_ctx);
void mi_session_uninit(void);
/**@brief Function for encrypt the data.
 *
 * @details After Secure auth login, device and application will both generate the
 * same session key. This key will used to encrypt the data by AES128-CCM. The
 * output is concatenating LSB of counter in nonce, cipher text and the MIC. So
 * the length of output buffer MUST be 6 bytes larger than input buffer.
 *
 * @param[in] input    plain text.
 * @param[in] len      plain text bytes.
 * @param[out] output  cipher text and 6-bytes extra info.
 */
int mi_session_encrypt(const uint8_t *input, uint16_t len, uint8_t *output);

/**@brief Function for handling the Xiaomi Service's BLE events.
 *
 * @param[in] input    cipher text and 6-bytes extra info.
 * @param[in] len      num of byte.
 * @param[out] output  plain text.
 */
int mi_session_decrypt(const uint8_t *input, uint16_t len, uint8_t *output);
#endif /* __MIBLE_CRYPTO_H__ */
```

## src/mible_dfu.h
```c
#ifndef MIBLE_DFU_H_
#define MIBLE_DFU_H_

#include <zephyr/types.h>
#include <stdbool.h>
#include <stdint.h>

#define RECORD_ID_DFU_INFO                      0x05

#define MIBLE_DFU_STATUS_SUCC                   0x00
#define MIBLE_DFU_STATUS_ERR_NO_CMD             0x01
#define MIBLE_DFU_STATUS_ERR_AUTH_FAIL          0x02
#define MIBLE_DFU_STATUS_ERR_INVALID            0x03
#define MIBLE_DFU_STATUS_ERR_NO_MEM             0x04
#define MIBLE_DFU_STATUS_ERR_BUSY               0x05
#define MIBLE_DFU_STATUS_ERR_UNSIGNED           0x06
#define MIBLE_DFU_STATUS_ERR_RX_FAIL            0x07
#define MIBLE_DFU_STATUS_ERR_LOW_BATTERY        0x08
#define MIBLE_DFU_STATUS_ERR_INVALID_VERSION    0x09
#define MIBLE_DFU_STATUS_ERR_UNKNOWN            0xFF

typedef enum {
    MIBLE_DFU_STATE_START,
    MIBLE_DFU_STATE_UPGRADE_STATUS,
    MIBLE_DFU_STATE_TRANSFER,
    MIBLE_DFU_STATE_VERIFY,
    MIBLE_DFU_STATE_SWITCH,
    MIBLE_DFU_STATE_TRANSFER_MCU,
    MIBLE_DFU_STATE_VERIFY_MCU,
    MIBLE_DFU_STATE_SWITCH_MCU,
    MIBLE_DFU_STATE_PROCESS,
    MIBLE_DFU_STATE_CANCEL,
} mible_dfu_state_t;

typedef struct {
    uint8_t major;
    uint8_t minor;
    uint8_t revision;
    uint16_t build;
}__packed mible_dfu_ver_t;

typedef struct {
    uint16_t fragment_size;
} mible_dfu_start_param_t;

typedef struct {
    uint16_t last_index;
} mible_dfu_trans_param_t;

typedef struct {
    uint8_t value;
    mible_dfu_ver_t version;
} mible_dfu_verify_param_t;

typedef struct {
    uint8_t up_to_app;
} mible_dfu_switch_param_t;

typedef struct {
    union {
        struct {
            uint8_t install     :1;
            uint8_t silent      :1;
            uint8_t reserved    :6;
        }_req;
        uint8_t  req;
    };

    union {
        struct {
            uint8_t install     :1;
            uint8_t silent      :1;
            uint8_t reserved    :6;
        }_rsp;
        uint8_t  rsp;
    };
} mible_dfu_upgrade_status_param_t;

typedef union {
    mible_dfu_start_param_t start;
    mible_dfu_trans_param_t trans;
    mible_dfu_verify_param_t verify;
    mible_dfu_switch_param_t switch_plan;
    mible_dfu_upgrade_status_param_t upgrade_status;
} mible_dfu_param_t;

typedef struct {
    uint16_t last_index;
    uint16_t rfu;
    uint32_t crc32;
    uint32_t recv_bytes;
} __packed mible_dfu_info_t;

void mible_dfu_init(void);
void set_dfu_switch_flag(void);
uint8_t mible_dfu_verify_process(void);
int dfu_info_check(uint16_t frag_idx, uint32_t crc32);
void dfu_try_switch_process(void *args);
int mcu_dfu_info_check(uint16_t frag_idx, uint32_t crc32);
int mcu_dfu_try_activate_new_fw(void);
int mible_dfu_mcu_ota_enable(void);
#endif //MIBLE_DFU_H_
```

## src/mible_mcu.h
```c
#ifndef MIBLE_MCU_H_
#define MIBLE_MCU_H_
#include <stdint.h>
#include "mible.h"
#include <nuttx/config.h>

#if defined(CONFIG_MIBLE_USE_MCU_OTA)
typedef enum {
    MIBLE_MCU_GET_VERSION,
    MIBLE_MCU_READ_DFUINFO,
    MIBLE_MCU_WRITE_DFUINFO,
    MIBLE_MCU_WRITE_FIRMWARE,
    MIBLE_MCU_VERIFY_FIRMWARE,
    MIBLE_MCU_UPGRADE_FIRMWARE,
    MIBLE_MCU_TRANSFER,
} mible_mcu_cmd_t;

typedef struct {
    uint32_t address;
    uint32_t length;
    void *p_data;
} mible_mcu_nvminfo_t;

mible_status_t mible_mcu_send_get_info(uint32_t *delay);
mible_status_t mible_mcu_read_get_info(uint8_t *buf);
void mible_mcu_read_dfuinfo(uint8_t *m_dfu_info, uint8_t len);
mible_status_t mible_mcu_write_dfuinfo(uint8_t *m_dfu_info, uint8_t len);
mible_status_t mible_mcu_upgrade_firmware(void);
mible_status_t mible_mcu_nvm_write(void *p_data, uint32_t length, uint32_t address);
mible_status_t mible_mcu_verify_firmware(void);
mible_status_t mible_mcu_cmd_send(mible_mcu_cmd_t cmd, void *arg);
mible_status_t mible_mcu_cmd_wait(mible_mcu_cmd_t cmd, void *arg);

int mible_mcu_init(void);
void mible_mcu_deinit(void);
mible_status_t mible_mcu_send_buffer(const uint8_t *pSend_Buf, uint16_t vCount);
void mible_mcu_send_byte(uint8_t byte);
int mible_mcu_flushinput(void);
mible_status_t mible_mcu_recv_bytes(void *bytes, uint16_t req_count, uint32_t timeout);
int mible_mcu_uart_recv_data(uint8_t *buf, size_t count,uint32_t timeout);
int mible_mcu_uart_send_data(uint8_t *buf, size_t count);
#endif
#endif /* MIBLE_MCU_H_ */
```
